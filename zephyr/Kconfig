## zephyr/Kconfig
```kconfig
mainmenu "SPI timestamp exchange"

source "Kconfig.zephyr"

menu "SPI timestamp exchange"

choice SPI_TIMESTAMP_ROLE
	prompt "SPI timestamp role"
	default ROLE_CONTROLLER

config ROLE_CONTROLLER
	bool "Controller"

config ROLE_TARGET
	bool "Target"

config ROLE_JITTER_CONTROLLER
	bool "Clock jitter controller"

config ROLE_JITTER_TARGET
	bool "Clock jitter target"

endchoice

config SYNTHETIC_LOAD_TEST
	bool "Enable synthetic CPU load thread"
	default n
	help
	  Starts a high-priority dummy thread to generate CPU contention for
	  synchronization stress testing.

config SYNTHETIC_LOAD_STACKSIZE
	int "Synthetic load thread stack size"
	default 1024
	depends on SYNTHETIC_LOAD_TEST
	range 512 8192

config SYNTHETIC_LOAD_PRIORITY
	int "Synthetic load thread priority"
	default 5
	depends on SYNTHETIC_LOAD_TEST
	range -20 99

config SYNTHETIC_LOAD_LOOP_ITERS
	int "Synthetic load loop iterations"
	default 100000
	depends on SYNTHETIC_LOAD_TEST
	range 1000 10000000

config SYNTHETIC_LOAD_BUSY_WAIT_US
	int "Synthetic load busy wait duration (us)"
	default 100
	depends on SYNTHETIC_LOAD_TEST
	range 0 1000000

config MCO_OUTPUT_ENABLE
	bool "Enable MCO output on PA8"
	default n
	depends on SOC_SERIES_STM32F1X
	help
	  Routes a clock to PA8 using the STM32F1 MCO hardware output.

choice MCO_OUTPUT_SOURCE
	prompt "MCO clock source"
	default MCO_OUTPUT_SOURCE_HSE
	depends on MCO_OUTPUT_ENABLE

config MCO_OUTPUT_SOURCE_HSE
	bool "HSE"

config MCO_OUTPUT_SOURCE_SYSCLK
	bool "SYSCLK"

endchoice

endmenu
```
